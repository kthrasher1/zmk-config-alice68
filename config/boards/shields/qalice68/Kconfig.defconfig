## config/boards/shields/qalice68/Kconfig.defconfig
```kconfig
# Copyright (c) 2020 The ZMK Contributors
# SPDX-License-Identifier: MIT

if SHIELD_QALICE68

config ZMK_KEYBOARD_NAME
    default "qalice68"

endif
```

## config/boards/shields/qalice68/Kconfig.shield
```kconfig
# Copyright (c) 2020 The ZMK Contributors
# SPDX-License-Identifier: MIT

config SHIELD_QALICE68
    def_bool $(shields_list_contains,qalice68)
```
